/**
 * @cliArgs --board "/boards/LAUNCHXL_F28379D" --context "CPU2" --product "C2000WARE@5.00.00.00"
 * @versions {"tool":"1.17.0+3128"}
 */

/**
 * Import the modules used in this configuration.
 */
const i2c  = scripting.addModule("/driverlib/i2c.js", {}, false);
const i2c1 = i2c.addInstance();
const ipc  = scripting.addModule("/driverlib/ipc.js");
const sci  = scripting.addModule("/driverlib/sci.js", {}, false);
const sci1 = sci.addInstance();

/**
 * Write custom configuration values to the imported modules.
 */
i2c1.$name              = "myI2C0";
i2c1.i2c.$assign        = "I2CA";
i2c1.i2c.sdaPin.$assign = "boosterpack1.10";
i2c1.i2c.sclPin.$assign = "boosterpack1.9";

ipc.ipcRegisterFlag          = ["IPC_FLAG1","IPC_FLAG31"];
ipc.enableInterrupt1         = true;
ipc.flagHandler31            = "IPC_SYNC";
ipc.registerInterrupts       = ["0"];
ipc.ipcInt0.enableInterrupt  = true;
ipc.ipcInt0.interruptHandler = "ipc0_ISR";

sci1.$name                    = "debuggerSerial";
sci1.registerInterrupts       = true;
sci1.enabledFIFOInterrupts    = ["SCI_INT_RXFF"];
sci1.rxFifo                   = "SCI_FIFO_RX1";
sci1.sci.$assign              = "SCIA";
sci1.sci.scirxdPin.$assign    = "GPIO43";
sci1.sci.scitxdPin.$assign    = "GPIO42";
sci1.sciRXInt.enableInterrupt = true;
scripting.suppress("Not pinned out,@@@.+?@@@ is not pinned out on the LaunchPad F28379D\\.  @@@.+?@@@", sci1.sci, "scirxdPin");
scripting.suppress("Not pinned out,@@@.+?@@@ is not pinned out on the LaunchPad F28379D\\.  @@@.+?@@@", sci1.sci, "scitxdPin");
