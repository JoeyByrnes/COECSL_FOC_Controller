/**
 * @cliArgs --board "/boards/LAUNCHXL_F28379D" --context "CPU1" --product "C2000WARE@5.00.00.00"
 * @versions {"tool":"1.17.0+3128"}
 */

/**
 * Import the modules used in this configuration.
 */
const adc         = scripting.addModule("/driverlib/adc.js", {}, false);
const adc1        = adc.addInstance();
const adc2        = adc.addInstance();
const adc3        = adc.addInstance();
const led         = scripting.addModule("/driverlib/board_components/led", {}, false);
const led1        = led.addInstance();
const led2        = led.addInstance();
const cla         = scripting.addModule("/driverlib/cla.js", {}, false);
const cla1        = cla.addInstance();
const epwm        = scripting.addModule("/driverlib/epwm.js", {}, false);
const epwm1       = epwm.addInstance();
const epwm2       = epwm.addInstance();
const epwm3       = epwm.addInstance();
const flash       = scripting.addModule("/driverlib/flash.js", {}, false);
const flash1      = flash.addInstance();
const gpio        = scripting.addModule("/driverlib/gpio.js", {}, false);
const gpio1       = gpio.addInstance();
const gpio2       = gpio.addInstance();
const gpio3       = gpio.addInstance();
const gpio4       = gpio.addInstance();
const ipc         = scripting.addModule("/driverlib/ipc.js");
const spi         = scripting.addModule("/driverlib/spi.js", {}, false);
const spi1        = spi.addInstance();
const spi2        = spi.addInstance();
const fastintdiv  = scripting.addModule("/libraries/math/FASTINTDIV/fastintdiv.js", {}, false);
const fastintdiv1 = fastintdiv.addInstance();
const FPUfastRTS  = scripting.addModule("/libraries/math/FPUfastRTS/FPUfastRTS.js", {}, false);
const FPUfastRTS1 = FPUfastRTS.addInstance();

/**
 * Write custom configuration values to the imported modules.
 */
adc1.$name                          = "myADC0";
adc1.enabledSOCs                    = ["ADC_SOC_NUMBER0"];
adc1.soc0Trigger                    = "ADC_TRIGGER_EPWM1_SOCA";
adc1.enabledInts                    = ["ADC_INT_NUMBER1"];
adc1.enableInterrupt1               = true;
adc1.registerInterrupts             = ["1"];
adc1.adcClockPrescaler              = "ADC_CLK_DIV_4_0";
adc1.enableInterrupt1ContinuousMode = true;
adc1.soc0Channel                    = "ADC_CH_ADCIN4";
adc1.soc0SampleWindow               = 16;
adc1.adcInt1.enableInterrupt        = true;

adc2.$name             = "myADC1";
adc2.adcBase           = "ADCB_BASE";
adc2.adcClockPrescaler = "ADC_CLK_DIV_4_0";
adc2.enabledSOCs       = ["ADC_SOC_NUMBER0"];
adc2.soc0Trigger       = "ADC_TRIGGER_EPWM1_SOCA";
adc2.soc0Channel       = "ADC_CH_ADCIN4";
adc2.soc0SampleWindow  = 16;
adc2.useInterrupts     = false;

adc3.$name             = "myADC2";
adc3.adcBase           = "ADCC_BASE";
adc3.adcClockPrescaler = "ADC_CLK_DIV_4_0";
adc3.enabledSOCs       = ["ADC_SOC_NUMBER0"];
adc3.soc0Trigger       = "ADC_TRIGGER_EPWM1_SOCA";
adc3.soc0Channel       = "ADC_CH_ADCIN4";
adc3.soc0SampleWindow  = 16;
adc3.useInterrupts     = false;

led1.$name                = "CPU1_LED";
led1.$hardware            = system.deviceData.board.components.LED4;
led1.gpio.gpioPin.$assign = "GPIO31";

led2.$name                = "CPU2_LED";
led2.$hardware            = system.deviceData.board.components.LED5;
led2.gpio.controllerCore  = "GPIO_CORE_CPU2";
led2.gpio.gpioPin.$assign = "GPIO34";

cla1.$name              = "myCLA0";
cla1.cpuint_CLA_TASK_7  = false;
cla1.cpuint_CLA_TASK_2  = false;
cla1.cpuint_CLA_TASK_3  = false;
cla1.cpuint_CLA_TASK_5  = false;
cla1.cpuint_CLA_TASK_4  = false;
cla1.cpuint_CLA_TASK_6  = false;
cla1.cpuint_CLA_TASK_8  = false;
cla1.trigger_CLA_TASK_1 = "CLA_TRIGGER_EPWM2INT";

const divider3       = system.clockTree["LOSPCP"];
divider3.divideValue = 1;

const pinFunction1     = system.clockTree["AUXCLK"];
pinFunction1.XTAL_Freq = 10;

const pinFunction2     = system.clockTree["X1"];
pinFunction2.XTAL_Freq = 10;

epwm1.$hardware                                                = system.deviceData.board.components.BP_SITE_1.subComponents.PWM_LOC1;
epwm1.epwmTimebase_hsClockDiv                                  = "EPWM_HSCLOCK_DIVIDER_1";
epwm1.epwmTimebase_period                                      = 2500;
epwm1.epwmTimebase_counterMode                                 = "EPWM_COUNTER_MODE_UP";
epwm1.epwmTimebase_forceSyncPulse                              = true;
epwm1.epwmActionQualifier_EPWM_AQ_OUTPUT_A_ON_TIMEBASE_ZERO    = "EPWM_AQ_OUTPUT_HIGH";
epwm1.epwmEventTrigger_enableInterrupt                         = true;
epwm1.epwmEventTrigger_registerInterrupts                      = true;
epwm1.epwmEventTrigger_interruptSource                         = "EPWM_INT_TBCTR_ZERO";
epwm1.epwmEventTrigger_interruptEventCount                     = "1";
epwm1.epwmEventTrigger_EPWM_SOC_A_triggerEnable                = true;
epwm1.epwmEventTrigger_EPWM_SOC_A_triggerEventPrescalar        = "1";
epwm1.$name                                                    = "PHASE_A";
epwm1.epwmCounterCompare_cmpD                                  = 2495;
epwm1.epwmTimebase_syncOutPulseMode                            = "EPWM_SYNC_OUT_PULSE_ON_COUNTER_COMPARE_D";
epwm1.hrpwm_syncSource                                         = "HRPWM_PWMSYNC_SOURCE_COMPD_UP";
epwm1.epwmActionQualifier_EPWM_AQ_OUTPUT_A_ON_TIMEBASE_UP_CMPB = "EPWM_AQ_OUTPUT_LOW";
epwm1.epwmCounterCompare_cmpA                                  = 2;
epwm1.epwmEventTrigger_EPWM_SOC_A_triggerSource                = "EPWM_SOC_TBCTR_U_CMPA";
epwm1.epwmInt.enableInterrupt                                  = true;
epwm1.epwmInt.interruptHandler                                 = "PWM_ISR";

epwm2.$hardware                                                = system.deviceData.board.components.BP_SITE_1.subComponents.PWM_LOC2;
epwm2.$name                                                    = "PHASE_B";
epwm2.copyFrom                                                 = "PHASE_A";
epwm2.epwmTimebase_hsClockDiv                                  = "EPWM_HSCLOCK_DIVIDER_1";
epwm2.epwmTimebase_period                                      = 2500;
epwm2.epwmTimebase_counterMode                                 = "EPWM_COUNTER_MODE_UP";
epwm2.hrpwm_syncSource                                         = "HRPWM_PWMSYNC_SOURCE_ZERO";
epwm2.epwmActionQualifier_EPWM_AQ_OUTPUT_A_ON_TIMEBASE_ZERO    = "EPWM_AQ_OUTPUT_HIGH";
epwm2.epwmCounterCompare_cmpD                                  = 2495;
epwm2.epwmTimebase_phaseEnable                                 = true;
epwm2.epwmTimebase_syncOutPulseMode                            = "EPWM_SYNC_OUT_PULSE_ON_EPWMxSYNCIN";
epwm2.epwmTimebase_phaseShift                                  = 2497;
epwm2.epwmActionQualifier_EPWM_AQ_OUTPUT_A_ON_TIMEBASE_UP_CMPB = "EPWM_AQ_OUTPUT_LOW";
epwm2.epwmCounterCompare_cmpC                                  = 2300;
epwm2.epwmEventTrigger_enableInterrupt                         = true;
epwm2.epwmEventTrigger_interruptEventCount                     = "1";
epwm2.epwmEventTrigger_interruptSource                         = "EPWM_INT_TBCTR_U_CMPC";
epwm2.epwmEventTrigger_registerInterrupts                      = true;
epwm2.epwmInt.enableInterrupt                                  = true;

epwm3.$hardware                                                = system.deviceData.board.components.BP_SITE_1.subComponents.PWM_LOC3;
epwm3.$name                                                    = "PHASE_C";
epwm3.copyFrom                                                 = "PHASE_A";
epwm3.epwmTimebase_hsClockDiv                                  = "EPWM_HSCLOCK_DIVIDER_1";
epwm3.epwmTimebase_period                                      = 2500;
epwm3.epwmTimebase_counterMode                                 = "EPWM_COUNTER_MODE_UP";
epwm3.hrpwm_syncSource                                         = "HRPWM_PWMSYNC_SOURCE_ZERO";
epwm3.epwmActionQualifier_EPWM_AQ_OUTPUT_A_ON_TIMEBASE_ZERO    = "EPWM_AQ_OUTPUT_HIGH";
epwm3.epwmCounterCompare_cmpD                                  = 2495;
epwm3.epwmTimebase_phaseEnable                                 = true;
epwm3.epwmTimebase_syncOutPulseMode                            = "EPWM_SYNC_OUT_PULSE_ON_EPWMxSYNCIN";
epwm3.epwmTimebase_phaseShift                                  = 2497;
epwm3.epwmActionQualifier_EPWM_AQ_OUTPUT_A_ON_TIMEBASE_UP_CMPB = "EPWM_AQ_OUTPUT_LOW";

flash1.$name = "myFMC0";

gpio1.$name             = "GPIO_DEBUG";
gpio1.direction         = "GPIO_DIR_MODE_OUT";
gpio1.writeInitialValue = true;
gpio1.gpioPin.$assign   = "boosterpack2.48";

gpio2.$name             = "CLA1_GPIO";
gpio2.direction         = "GPIO_DIR_MODE_OUT";
gpio2.writeInitialValue = true;
gpio2.controllerCore    = "GPIO_CORE_CPU1_CLA1";
gpio2.gpioPin.$assign   = "boosterpack1.8";

gpio3.$name             = "DRV_EN";
gpio3.writeInitialValue = true;
gpio3.direction         = "GPIO_DIR_MODE_OUT";

gpio4.$name = "DRV_NFAULT";

ipc.ipcRegisterFlag          = ["IPC_FLAG0","IPC_FLAG31"];
ipc.flagHandler31            = "IPC_SYNC";
ipc.registerInterrupts       = ["1"];
ipc.enableInterrupt0         = true;
ipc.ipcInt1.enableInterrupt  = true;
ipc.ipcInt1.interruptHandler = "ipc1_ISR";

spi1.$name     = "mySPI0";
spi1.mode      = "SPI_MODE_CONTROLLER";
spi1.$hardware = system.deviceData.board.components.BP_SITE_1.subComponents.SPI;
spi1.bitRate   = 20000000;

spi2.$name     = "mySPI1";
spi2.$hardware = system.deviceData.board.components.BP_SITE_2.subComponents.SPI;
spi2.bitRate   = 2500000;
spi2.mode      = "SPI_MODE_CONTROLLER";

fastintdiv1.$name = "myFID0";

FPUfastRTS1.$name = "myFFR0";

/**
 * Pinmux solution for unlocked pins/peripherals. This ensures that minor changes to the automatic solver in a future
 * version of the tool will not impact the pinmux you originally saw.  These lines can be completely deleted in order to
 * re-solve from scratch.
 */
epwm1.epwm.$suggestSolution           = "EPWM1";
epwm1.epwm.epwm_aPin.$suggestSolution = "boosterpack1.40";
epwm1.epwm.epwm_bPin.$suggestSolution = "boosterpack1.39";
epwm2.epwm.$suggestSolution           = "EPWM2";
epwm2.epwm.epwm_aPin.$suggestSolution = "boosterpack1.38";
epwm2.epwm.epwm_bPin.$suggestSolution = "boosterpack1.37";
epwm3.epwm.$suggestSolution           = "EPWM3";
epwm3.epwm.epwm_aPin.$suggestSolution = "boosterpack1.36";
epwm3.epwm.epwm_bPin.$suggestSolution = "boosterpack1.35";
gpio3.gpioPin.$suggestSolution        = "boosterpack1.17";
gpio4.gpioPin.$suggestSolution        = "boosterpack1.18";
spi1.spi.$suggestSolution             = "SPIA";
spi1.spi.spi_picoPin.$suggestSolution = "boosterpack1.15";
spi1.spi.spi_pociPin.$suggestSolution = "boosterpack1.14";
spi1.spi.spi_clkPin.$suggestSolution  = "boosterpack1.7";
spi1.spi.spi_ptePin.$suggestSolution  = "boosterpack1.19";
spi2.spi.$suggestSolution             = "SPIB";
spi2.spi.spi_picoPin.$suggestSolution = "boosterpack2.55";
spi2.spi.spi_pociPin.$suggestSolution = "boosterpack2.54";
spi2.spi.spi_clkPin.$suggestSolution  = "boosterpack2.47";
spi2.spi.spi_ptePin.$suggestSolution  = "boosterpack2.59";
